## config/west.yml
```yaml
manifest:
  remotes:
    - name: zmkfirmware
      url-base: https://github.com/zmkfirmware
    - name: jamescodesthings
      url-base: https://github.com/jamescodesthings
  projects:
    - name: zmk
      remote: jamescodesthings
      revision: bbkeyboard_tp
      import: app/west.yml
  self:
    path: config
```
